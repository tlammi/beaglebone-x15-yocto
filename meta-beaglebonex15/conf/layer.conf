## meta-beaglebonex15/conf/layer.conf
```bitbake
BBPATH .= ":${LAYERDIR}"

# We have a recipes directory, add to BBFILES
BBFILES += "${LAYERDIR}/recipes*/*/*.bb ${LAYERDIR}/recipes*/*/*.bbappend"

BBFILE_COLLECTIONS += "meta-beaglebonex15"
BBFILE_PATTERN_meta-beaglebonex15 := "^${LAYERDIR}/"
BBFILE_PRIORITY_meta-beaglebonex15 = "6"
LAYERSERIES_COMPAT_meta-beaglebonex15 = "sumo thud"
```
